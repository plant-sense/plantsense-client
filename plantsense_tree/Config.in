## plantsense_tree/package/Config.in
```kconfig
menu "Plantsense Packages"
	source "$BR2_EXTERNAL_plantsense_tree_PATH/package/monitoring_agent/Config.in"
	source "$BR2_EXTERNAL_plantsense_tree_PATH/package/nanomq/Config.in"
	source "$BR2_EXTERNAL_plantsense_tree_PATH/package/test/Config.in"
	source "$BR2_EXTERNAL_plantsense_tree_PATH/package/zigbee2mqtt/Config.in"
endmenu
```

## plantsense_tree/package/monitoring_agent/Config.in
```kconfig
config BR2_PACKAGE_PLANTSENSE_MONITORING_AGENT
	bool "plantsense_monitoring_agent"
	select BR2_PACKAGE_HIREDIS
	help
		The custom monitoring agent for the plantsense project
```

## plantsense_tree/package/nanomq/Config.in
```kconfig
config BR2_PACKAGE_NANOMQ
	bool "nanomq"
	help
		Buildroot package for NanoMQ, a lightweight, high-performance MQTT messaging broker
```

## plantsense_tree/package/z2m_spoof/Config.in
```kconfig
config BR2_PACKAGE_Z2M_SPOOF
	bool "z2m_spoof"
	help
		Package for simulating zigbee2mqtt devices
```

## plantsense_tree/package/zigbee2mqtt/Config.in
```kconfig
config BR2_PACKAGE_ZIGBEE2MQTT
    bool "zigbee2mqtt"
    select BR2_PACKAGE_NODEJS_NPM
    help
        Buildroot package for zigbee2mqtt
```
